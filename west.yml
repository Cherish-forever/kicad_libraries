## west.yml
```yaml
# The west manifest file for Kicad libraries.
#
# The per-installation west configuration file, .west/config, sets the
# path to the project containing this file in the [manifest] section's
# "path" variable.
#
# You are free to create your own manifest files and put them in any
# repository you want, to create your own custom kicad libraries installations.
# For example, you could create a manifest file in your own out of
# tree application directory, which would pull this kicad library repository
# in as an ordinary project.
#
# You can pass your manifest repositories to west init when creating a
# new kicad libraries installation. See the west documentation for more
# information.

manifest:
  defaults:
    remote: origin

  remotes:
    - name: origin
      url-base: https://github.com

  self:
    path: .kicad_libraries
    west-commands: scripts/west-commands.yml
    import: submanifests
```
